## conf/machine/odroid-xu4.conf
```bitbake
#@TYPE: Machine
#@NAME: odroid-xu4
#@DESCRIPTION: Machine configuration for odroid-xu4 systems
#@MAINTAINER: Gustavo Branco <guster32@gmail.com>

include conf/machine/include/odroid-xu-default.inc

TCLIBC = "glibc"
UBOOT_ENV_SUFFIX = "ini"
MACHINE_FEATURES:append = " emmc mali"
KERNEL_DEVICETREE ?= "exynos5422-odroidxu4.dtb"

# U-BOOT_MACHINE / UBOOT_BINARY moved into the u-boot-hardkernel recipe
# (recipes-bsp/u-boot/u-boot-hardkernel_2026.01.bb) using the wrynose 6.0
# UBOOT_CONFIG[] flag syntax.
```
